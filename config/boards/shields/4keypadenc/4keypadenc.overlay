#include <dt-bindings/zmk/matrix_transform.h>

/{
    chosen {
        zmk,kscan = &default_kscan;
        zmk,matrix_transform = &default_transform;
    };

    default_kscan: kscan{
        compatible = "zmk,kscan-gpio-matrix";
        label = "default_kscan";
        diode-direction = "col2row";
        wakeup-source;
 
        row-gpios = <&gpio0 24  (GPIO_ACTIVE_HIGH | GPIO_PULL_DOWN)>;  // D5-024

        col-gpios = <&gpio0 9 GPIO_ACTIVE_HIGH>, // D10-009
                    <&gpio0 10 GPIO_ACTIVE_HIGH>, // D16-010
                    <&gpio1 11 GPIO_ACTIVE_HIGH>, // D14-111
                    <&gpio1 13 GPIO_ACTIVE_HIGH>; // D15-113
    };

    default_transform: matrix_transform {
        compatible ="zmk,matrix-transform";
        rows = <1>;
        columns = <4>;

        map = <
            RC(0,0) RC(0,1) RC(0,2) RC(0,3)
        >;
    };

};
