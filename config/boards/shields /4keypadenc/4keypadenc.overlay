#include <dt-bindings/zmk/matrix_transform.h>

/{
    chosen {
        zmk,kscan = &default_kscan;
        zmk,matrix_transform = &default_transform;
    };

    default_kscan: kscan{
        compatible = "zmk,kscan-gpio-matrix";
        label = "default_kscan";
        diode-direction = "col2row";
        wakeup-source;
 
        row-gpios = <&gpio0 9  (GPIO_ACTIVE_HIGH | GPIO_PULL_DOWN)>,  // D10
                    <&gpio1 13  (GPIO_ACTIVE_HIGH | GPIO_PULL_DOWN)>;  // D15

        col-gpios = <&gpio0 29 GPIO_ACTIVE_HIGH>, // D20
                    <&gpio0 10 GPIO_ACTIVE_HIGH>; // D16
    };

    default_transform: matrix_transform {
        compatible ="zmk,matrix-transform";
        rows = <2>;
        columns = <2>;

        map = <
            RC(0,0) RC(1,0) RC(0,1) RC(1,1)
        >;
    };

};
